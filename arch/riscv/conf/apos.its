## arch/riscv/conf/apos.its
```
/dts-v1/;

/ {
	description = "FUCK";
#address-cells = <1>;

	images {
		kernel {
			description = "Garbaggio";
			data = /incbin/("../../../apos.bin");
			type = "kernel";
			arch = "riscv";
			os = "apos";
			compression = "none";
			load = <0x83800000>;
			entry = <0x83800000>;
			hash-1 {
				algo = "sha1";
			};
		};

		initrd {
			description = "Gargabbio initrd";
			data = /incbin/("initrd.txt");
			type = "ramdisk";
			arch = "riscv";
			os = "apos";
			compression = "none";
			load = <0x88300000>;
			hash-1 {
				algo = "sha1";
			};
		};
	};

	configurations {
		default = "config";

		config {
			description = "Default configuration";
			kernel = "kernel";
			ramdisk = "initrd";
			hash-1 {
				algo = "sha1";
			};
		};
	};
};
```

## arch/riscv64/conf/apos.its
```
/dts-v1/;

/ {
	description = "FUCK";
#address-cells = <1>;

	images {
		kernel {
			description = "Garbaggio";
			data = /incbin/("../../../apos.bin");
			type = "kernel";
			arch = "riscv";
			os = "apos";
			compression = "none";
			load = <0x80240000>;
			entry = <0x80240000>;
			hash-1 {
				algo = "sha1";
			};
		};

		initrd {
			description = "Gargabbio initrd";
			data = /incbin/("initrd");
			type = "ramdisk";
			arch = "riscv";
			os = "apos";
			compression = "none";
			load = <0x88300000>;
			hash-1 {
				algo = "sha1";
			};
		};
	};

	configurations {
		default = "config";

		config {
			description = "Default configuration";
			kernel = "kernel";
			ramdisk = "initrd";
			hash-1 {
				algo = "sha1";
			};
		};
	};
};
```

## arch/riscv64/conf/kmi.its
```
/dts-v1/;

/ {
	description = "FUCK";
#address-cells = <1>;

	images {
		kernel {
			description = "Garbaggio";
			data = /incbin/("../../../kmi.bin");
			type = "kernel";
			arch = "riscv";
			os = "kmi";
			compression = "none";
			load = <0x80260000>;
			entry = <0x80260000>;
			hash-1 {
				algo = "sha1";
			};
		};

		initrd {
			description = "Gargabbio initrd";
			data = /incbin/("initrd");
			type = "ramdisk";
			arch = "riscv";
			os = "kmi";
			compression = "none";
			load = <0x88300000>;
			hash-1 {
				algo = "sha1";
			};
		};
	};

	configurations {
		default = "config";

		config {
			description = "Default configuration";
			kernel = "kernel";
			ramdisk = "initrd";
			hash-1 {
				algo = "sha1";
			};
		};
	};
};
```
